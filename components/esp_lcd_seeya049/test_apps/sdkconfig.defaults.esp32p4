## components/esp_lcd_seeya049/test_apps/sdkconfig.defaults.esp32p4
```kconfig
CONFIG_IDF_TARGET="esp32p4"
CONFIG_ESPTOOLPY_FLASHSIZE_16MB=y
CONFIG_COMPILER_OPTIMIZATION_PERF=y
CONFIG_SPIRAM=y
CONFIG_SPIRAM_SPEED_200M=y
CONFIG_SPIRAM_MEMTEST=n
CONFIG_LOG_MAXIMUM_LEVEL_DEBUG=y
CONFIG_IDF_EXPERIMENTAL_FEATURES=y
```

## components/sths34pf80/test_apps/main/Kconfig.projbuild
```kconfig
menu "STHS34PF80 Test Configuration"

    config TEST_I2C_PORT_NUM
        int "I2C port number"
        default 0
        help
            I2C port number to use for the test

    config TEST_I2C_SCL_GPIO
        int "I2C SCL GPIO number"
        default 19 if IDF_TARGET_ESP32
        default 9 if IDF_TARGET_ESP32C3 || IDF_TARGET_ESP32C6 || IDF_TARGET_ESP32H2
        default 2 if IDF_TARGET_ESP32S2 || IDF_TARGET_ESP32S3
        default 52 if IDF_TARGET_ESP32P4
        help
            GPIO number for I2C SCL line

    config TEST_I2C_SDA_GPIO
        int "I2C SDA GPIO number"
        default 18 if IDF_TARGET_ESP32
        default 8 if IDF_TARGET_ESP32C3 || IDF_TARGET_ESP32C6 || IDF_TARGET_ESP32H2
        default 1 if IDF_TARGET_ESP32S2 || IDF_TARGET_ESP32S3
        default 53 if IDF_TARGET_ESP32P4
        help
            GPIO number for I2C SDA line

    config TEST_I2C_DEVICE_ADDR
        hex "STHS34PF80 I2C device address"
        default 0x5A
        help
            I2C device address of STHS34PF80 sensor (0x5A)

    config TEST_INTERRUPT_GPIO
        int "GPIO connected to interrupt pin"
        default 9

endmenu
```

## sdkconfig.defaults.m5stack-atom-display
```kconfig
CONFIG_ESP_TASK_WDT_CHECK_IDLE_TASK_CPU1=n
CONFIG_ESPTOOLPY_FLASHSIZE_16MB=y
CONFIG_PARTITION_TABLE_CUSTOM=y
CONFIG_PARTITION_TABLE_CUSTOM_FILENAME="esp32s3-16MB.csv"
CONFIG_LEDC_BACKLIGHT=n
CONFIG_USE_LTR329=n
CONFIG_USE_MMC5603=n
CONFIG_DISPLAY_M5STACK_ATOM_DISPLAY=y
CONFIG_RED_LED=18
CONFIG_GREEN_LED=18
CONFIG_BLUE_LED=18
CONFIG_USB_CONNECTED_PIN=-1
CONFIG_MAX_BYTES_PER_PARAGRAPH=10003;
CONFIG_MAX_BYTES_PER_DISPLAY_PAGE=7500
CONFIG_CSTR_POOL_SIZE=5000
CONFIG_TOKENS_SIZE=1250
CONFIG_MAX_BYTES_PER_LINE=300
CONFIG_LINES_SIZE=40
```

## src/Kconfig.projbuild
```kconfig
menu "Sol Options"

    menu "Display Settings"
        choice
            prompt "Select Display Type"
            default DISPLAY_EINKET013TT1

            config DISPLAY_EINKET013TT1
                bool "E-Ink ET013TT1 Display"

            config DISPLAY_M5STACK_ATOM_DISPLAY
                bool "M5Stack Atom Display (HDMI)"

            config DISPLAY_M5STACK_MODULE_DISPLAY
                bool "M5Stack Module Display (HDMI)"

            config DISPLAY_WAVESHARE_6INHD
                bool "Waveshare 6in HD Display"

            config DISPLAY_SHARP_27IN
                bool "Sharpmem 2.7in Display"
        endchoice

        config DISPLAY_PIXEL_RESOLUTION_IS_FIX
            bool "Display pixel resolution is unchangeable at runtime."
            default y

        config TTF_SCREEN_RES_PER_INCH
            int "Screen resolution per inch (for TTF sizing)"
            default 150

        config DISPLAY_WIDTH
            int "Display Width"
            default 1440 if DISPLAY_WAVESHARE_6INHD
            default 400 if DISPLAY_SHARP_27IN
            default 1280 if DISPLAY_M5STACK_ATOM_DISPLAY
            default 1920 if DISPLAY_M5STACK_MODULE_DISPLAY
            default 256

        config DISPLAY_HEIGHT
            int "Display Height"
            default 1072 if DISPLAY_WAVESHARE_6INHD
            default 240 if DISPLAY_SHARP_27IN
            default 720 if DISPLAY_M5STACK_ATOM_DISPLAY
            default 1080 if DISPLAY_M5STACK_MODULE_DISPLAY
            default 256

        menu "Display Pins"
            config DISPLAY_EINKET013TT1_CS_LEFT
                depends on DISPLAY_EINKET013TT1
                int "CS Left Pin"
                default 21

            config DISPLAY_EINKET013TT1_CS_RIGHT
                depends on DISPLAY_EINKET013TT1
                int "CS Right Pin"
                default 11

            config DISPLAY_EINKET013TT1_RST
                depends on DISPLAY_EINKET013TT1
                int "RST Pin"
                default 9

            config DISPLAY_EINKET013TT1_MOSI
                depends on DISPLAY_EINKET013TT1
                int "MOSI Pin"
                default 12

            config DISPLAY_EINKET013TT1_MISO
                depends on DISPLAY_EINKET013TT1
                int "MISO Pin"
                default 14

            config DISPLAY_EINKET013TT1_CLK
                depends on DISPLAY_EINKET013TT1
                int "CLK Pin"
                default 13

            config DISPLAY_WAVESHARE_6INHD_MOSI
                depends on DISPLAY_WAVESHARE_6INHD
                int "MOSI Pin"
                default 35

            config DISPLAY_WAVESHARE_6INHD_MISO
                depends on DISPLAY_WAVESHARE_6INHD
                int "MISO Pin"
                default 37

            config DISPLAY_WAVESHARE_6INHD_CLK
                depends on DISPLAY_WAVESHARE_6INHD
                int "CLK Pin"
                default 34

            config DISPLAY_WAVESHARE_6INHD_BUSY
                depends on DISPLAY_WAVESHARE_6INHD
                int "BUSY Pin"
                default 6

            config DISPLAY_WAVESHARE_6INHD_CS
                depends on DISPLAY_WAVESHARE_6INHD
                int "CS Pin"
                default 3

            config DISPLAY_WAVESHARE_6INHD_RESET
                depends on DISPLAY_WAVESHARE_6INHD
                int "RESET Pin"
                default 5

            config DISPLAY_SHARP_27IN_MOSI
                depends on DISPLAY_SHARP_27IN
                int "MOSI Pin"
                default 35

            config DISPLAY_SHARP_27IN_CLK
                depends on DISPLAY_SHARP_27IN
                int "CLK Pin"
                default 36

            config DISPLAY_SHARP_27IN_CS
                depends on DISPLAY_SHARP_27IN
                int "CS Pin"
                default 34

            config DISPLAY_SHARP_27IN_DISP
                depends on DISPLAY_SHARP_27IN
                int "DISP Pin"
                default 6
        endmenu
    endmenu

    menu "BLE Settings"
        config USE_BLE_SERVER_REMOTE
            bool "Enable BLE Server Remote"
            default y

        config USE_BLE_SERVER_SETTINGS
            bool "Enable BLE Server Settings"
            default y

        config USE_BLE_SERVER_PROXY
            bool "Enable BLE Server Proxy"
            default y

        config USE_BLE_SERVER_IMPROV
            bool "Enable BLE Server Improv"
            default y

        config USE_TURN_TOUCH_REMOTE
            bool "Enable Turn Touch Remote"
            default y
    endmenu

    menu "Peripheral Settings"
        config BOARD_HAS_PSRAM
            bool "Board has PSRAM"
            default y

        config INTERNAL_SPIFFS_FLASH
            bool "Internal SPIFFS Flash"
            default y

        config LEDC_BACKLIGHT
            bool "LEDC Backlight"
            default y

        config USE_LTR329
            bool "Use LTR329 Ambient Light Sensor"
            default y

        config USE_MMC5603
            bool "Use MMC5603 Magnetometer"
            default y

        config USE_SYS_ON
            bool "Use SYS_ON Pin"
            default y if DISPLAY_EINKET013TT1
            default n

        config DEFAULT_INACTIVITY_MINUTES
            int "Default Inactivity Minutes"
            default 10

        config LED_INVERT
            bool "LED Invert"
            default y

        config USE_TINYUSB_SERIAL
            bool "Use TinyUSB for Serial Communication"
            default y

        config DISABLE_POWER_MANAGEMENT
            bool "Disable Power Management"
            default n

        config BAT_VOLTAGE_RIGHT_PIN
            int "Battery Voltage Right Pin"
            default 10

        config BAT_VOLTAGE_LEFT_PIN
            int "Battery Voltage Left Pin"
            default 4

        config BAT_VOLTAGE_UPPER_DIVIDER
            int "Battery Voltage Upper Divider"
            default 442

        config BAT_VOLTAGE_LOWER_DIVIDER
            int "Battery Voltage Lower Divider"
            default 160

        config FACTORY_RESET_BUTTON_PIN
            int "Factory Reset Button Pin"
            default 0

        config USE_WIFI
            bool "Use WiFi"
            default y

    endmenu

    menu "Pin Selection"
        config RED_LED
            int "Red LED Pin"
            default 7

        config GREEN_LED
            int "Green LED Pin"
            default 6

        config BLUE_LED
            int "Blue LED Pin"
            default 18

        config USB_CONNECTED_PIN
            int "USB Connected Pin"
            default 8

        config BACKLIGHT_RIGHT
            int "Backlight Right Pin"
            default 2

        config BACKLIGHT_LEFT
            int "Backlight Left Pin"
            default 17

        config DISPLAY_POWER
            int "Display Power Pin"
            default -1
    endmenu

    menu "Renderer Settings"
        config MAX_BYTES_PER_PARAGRAPH
            int "Max Bytes Per Paragraph"
            default 5003
        config MAX_BYTES_PER_DISPLAY_PAGE
            int "Max Bytes Per Display Page"
            default 2400
        config CSTR_POOL_SIZE
            int "CStr Pool Size"
            default 2000
        config TOKENS_SIZE
            int "Tokens Size"
            default 500
        config MAX_BYTES_PER_LINE
            int "Max Bytes Per Line"
            default 200
        config LINES_SIZE
            int "Lines Size"
            default 36

        choice
            prompt "Font System"
            default FONT_IBMF if DISPLAY_EINKET013TT1 || DISPLAY_SHARP_27IN
            default FONT_TTF
    
            config FONT_IBMF
                bool "IBMF 1bpp Sol Sans Font"

            config FONT_TTF
                bool "TTF Font via FreeType"

        endchoice
        
    endmenu

    menu "Content Settings"
        config INCLUDE_DEFAULT_CONTENT
            bool "Include Default Content"
            default y

    endmenu

endmenu
```
